## build/conf/local.conf
```bitbake
CONF_VERSION            = "2"

DISTRO                  = "speedy-oe"
MACHINE                 = "speedy-box"

PACKAGE_CLASSES         = "package_ipk"
SDKMACHINE              = "x86_64"

USER_CLASSES            ?= "buildstats"

PATCHRESOLVE            = "noop"

BB_DISKMON_DIRS ??= "\
    STOPTASKS,${TMPDIR},1G,100K \
    STOPTASKS,${DL_DIR},1G,100K \
    STOPTASKS,${SSTATE_DIR},1G,100K \
    STOPTASKS,/tmp,100M,100K \
    HALT,${TMPDIR},100M,1K \
    HALT,${DL_DIR},100M,1K \
    HALT,${SSTATE_DIR},100M,1K \
    HALT,/tmp,10M,1K \
"

PACKAGECONFIG:append:pn-qemu-system-native = " sdl"

KERNEL_MODULE_AUTOLOAD:append = " i2c-dev spidev"

TMPDIR                  = "/yocto/tmp"
DL_DIR                  = "/yocto/downloads"
SSTATE_DIR              = "/yocto/sstate-cache"


SPEEDY_WIFI_SSID = "."
SPEEDY_WIFI_PASS = "."
```

## meta-speedy/conf/distro/speedy-oe.conf
```bitbake
require conf/distro/poky.conf

DISTRO = "speedy-oe"
DISTROOVERRIDES =. "speedy-oe:"
DISTRO_NAME = "Distro based on OE for Speedy Box"
DISTRO_VERSION = "1.0.0"
DISTRO_CODENAME = "scarthgap"

ROOT_HOME ??= "/root"
VOLATILE_LOG_DIR = "no"

INIT_MANAGER = "sysvinit"

## remove the .rootfs in image name
IMAGE_NAME_SUFFIX = ""

## remove the -raspberrypiX-bit from image name
IMAGE_MACHINE_SUFFIX = ""


PREFERRED_PROVIDER_u-boot-fw-utils = "libubootenv"
```

## meta-speedy/conf/layer.conf
```bitbake
# We have a conf and classes directory, add to BBPATH
BBPATH .= ":${LAYERDIR}"

# We have recipes-* directories, add to BBFILES
BBFILES += "${LAYERDIR}/recipes-*/*/*.bb \
            ${LAYERDIR}/recipes-*/*/*.bbappend"

BBFILE_COLLECTIONS += "meta-speedy"
BBFILE_PATTERN_meta-speedy = "^${LAYERDIR}/"
BBFILE_PRIORITY_meta-speedy = "30"

LAYERDEPENDS_meta-speedy = "core"
LAYERSERIES_COMPAT_meta-speedy = "scarthgap"
```

## meta-speedy/conf/machine/speedy-box.conf
```bitbake
MACHINEOVERRIDES =. "speedy-box:"

MACHINE_EXTRA_RRECOMMENDS += "\
    linux-firmware-rpidistro-bcm43430 \
    linux-firmware-rpidistro-bcm43455 \
    bluez-firmware-rpidistro-bcm43430a1-hcd \
    bluez-firmware-rpidistro-bcm4345c0-hcd \
"

require conf/machine/include/arm/armv8a/tune-cortexa53.inc
include conf/machine/include/rpi-base.inc

RPI_KERNEL_DEVICETREE = " \
    broadcom/bcm2710-rpi-3-b.dtb \
    broadcom/bcm2710-rpi-3-b-plus.dtb \
    broadcom/bcm2837-rpi-3-b.dtb \
    broadcom/bcm2710-rpi-cm3.dtb \
"

SDIMG_KERNELIMAGE ?= "kernel8.img"

# When u-boot is enabled we need to use the "Image" format and the "booti"
# command to load the kernel
KERNEL_IMAGETYPE_UBOOT ?= "Image"

# "zImage" not supported on arm64 and ".gz" images not supported by bootloader yet
KERNEL_IMAGETYPE_DIRECT ?= "Image"
KERNEL_BOOTCMD ?= "booti"
UBOOT_MACHINE = "rpi_arm64_config"
SERIAL_CONSOLES ?= "115200;ttyS0"

VC4DTBO ?= "vc4-fkms-v3d"
ARMSTUB ?= "armstub8.bin"


### some defaults
BOOT_DELAY = "0"
BOOT_DELAY_MS = "0"
DISABLE_SPLASH = "1"
DISABLE_OVERSCAN = "1"

VIDEO_CAMERA = "0"
DISABLE_RPI_BOOT_LOGO = "1"

ENABLE_W1 = "0"
ENABLE_I2C = "1"
ENABLE_SPI_BUS = "1"
ENABLE_DWC2_PERIPHERAL = "1"
ENABLE_DWC2_HOST = "1"

RPI_USE_U_BOOT = "1"

LICENSE_FLAGS_ACCEPTED = "synaptics-killswitch"

RPI_KERNEL_DEVICETREE_OVERLAYS:append = " overlays/spi4-1cs.dtbo"
```

## meta-speedy/wic/speedy-sdcard.wks
```
# short-description: Create Raspberry Pi SD card image
# long-description: Creates a partitioned SD card image for use with
# Raspberry Pi. Boot files are located in the first vfat partition.

part /boot --source bootimg-partition --ondisk mmcblk0 --fstype=vfat --label boot --active --align 4096 --size 100
part / --source rootfs --ondisk mmcblk0 --fstype=ext4 --label root1 --align 4096
part --source rootfs --ondisk mmcblk0 --fstype=ext4 --label root2 --align 4096
part /apps --size 512 --ondisk mmcblk0 --fstype=ext4 --label apps --align 4096
```
